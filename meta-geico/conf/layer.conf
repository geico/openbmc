## meta-geico/conf/layer.conf
```bitbake
# We have a conf and classes directory, add to BBPATH
BBPATH =. "${LAYERDIR}:"

# We have recipes-* directories, add to BBFILES
BBFILES += "${LAYERDIR}/recipes-*/*/*.bb \
            ${LAYERDIR}/recipes-*/*/*.bbappend"

BBFILE_COLLECTIONS += "geico-layer"
BBFILE_PATTERN_geico-layer := "^${LAYERDIR}/"

LAYERSERIES_COMPAT_geico-layer = "nanbield scarthgap"

QCOMBASE = '${@os.path.normpath("${LAYERDIR}/")}'
```
